#include <Wire.h>
#include <Adafruit_SSD1306.h>
#include <Adafruit_GFX.h>

Adafruit_SSD1306 lcd(128, 32, &Wire, 4);
#define SCREEN_I2C_ADDR 0x3C // or 0x3C
#define SCREEN_WIDTH 128     // OLED display width, in pixels
#define SCREEN_HEIGHT 32     // OLED display height, in pixels
#define OLED_RST_PIN -1
#define btnOk   4

boolean statusBtnOk   = false;
boolean statusAkhirBtnOk   = false;
boolean OK   = false;

int halaman  = 1;
int menuItem = 1;

//date
#define FRAME_DELAY (10)
#define FRAME_WIDTH (32)
#define FRAME_HEIGHT (32)
#define FRAME_COUNT (sizeof(date1) / sizeof(date1[0]))
const byte PROGMEM date1[][128] = {
  {1,192,3,128,3,64,2,192,3,96,6,192,127,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0,0},
  {1,192,3,128,3,64,2,192,3,96,6,192,127,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0,0},
  {1,192,3,128,3,64,2,192,3,96,6,192,127,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0,0},
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  {1,192,3,128,3,64,2,192,3,96,6,192,127,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0,0}
};

#define FRAME_DELAY (10)
#define FRAME_WIDTH (32)
#define FRAME_HEIGHT (32)
#define FRAME_COUNT (sizeof(date2) / sizeof(date2[0]))
const byte PROGMEM date2[][128] = {
  {1,192,3,128,3,64,2,192,3,96,6,192,63,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0,0},
  {1,192,3,128,3,64,2,192,3,96,6,192,63,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0,0},
  {1,192,3,128,3,64,2,192,3,96,6,192,63,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0,0},
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  {1,192,3,128,3,64,2,192,3,96,6,192,63,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0,0}
};

//Cake
#define FRAME_DELAY (10)
#define FRAME_WIDTH (32)
#define FRAME_HEIGHT (32)
#define FRAME_COUNT (sizeof(cake) / sizeof(cake[0]))
const byte PROGMEM cake[][128] = {
  {0,0,0,0,0,0,0,0,0,1,128,0,0,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0,0},
  {0,0,0,0,0,0,128,0,0,1,128,0,0,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0,0},
  {0,0,0,0,0,0,128,0,0,1,128,0,0,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0,0},
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  {0,0,0,0,0,1,0,0,0,1,128,0,0,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0,0}
};


void setup() {
  Serial.begin(115200);
  lcd.begin(SSD1306_SWITCHCAPVCC, 0x3C);
  lcd.clearDisplay();

  pinMode(btnOk,   INPUT_PULLUP);
}
int frame = 0;
void loop() {
  tampil();

  statusBtnOk   = digitalRead(btnOk);

  saatOkDitekan();

  if (OK) {
OK = false;
    if (halaman == 1 && menuItem == 1) {
      halaman = 2;
    } else if (halaman == 2 && halaman == 2) {
      halaman = 3;
    } else if (halaman == 3 && halaman == 3) {
      halaman = 4;
    } else if (halaman == 4 && halaman == 4) {
      halaman = 5;
    } else if (halaman == 5 && halaman == 5) {
      halaman = 6;
    }
  }

  Serial.println(menuItem);
  delay(100);

}

void saatOkDitekan() {
  if (statusBtnOk != statusAkhirBtnOk) {
    if (statusBtnOk == 0) {
      OK = true;
    }
    delay(50);
  }
  statusAkhirBtnOk = statusBtnOk;
}

//---------KLIK BUTTON--------
void tampil() {
  if (halaman == 1) {   
    lcd.clearDisplay();
    lcd.setTextSize(1);
    lcd.setTextColor(WHITE);
    lcd.setCursor(40, 5);
    lcd.print("Haii Fatma");

    if (menuItem == 1) {   //Jam
      lcd.setTextSize(1);
      lcd.setCursor(46, 20);
      lcd.setTextColor(WHITE);
      lcd.print("<(Buka)>");
    } 
//-----------yang akan tampil ketika di klik----------

// hal1
  } else if (halaman == 2) {
    
    lcd.clearDisplay();

    lcd.setTextSize(1);
    lcd.setTextColor(WHITE);
    lcd.setCursor(35, 5);
    lcd.print("Sekarang tgl");
    lcd.setTextSize(1);
    lcd.setCursor(35,15);
    lcd.print("berapa yaa");
    lcd.setCursor(35,25);
    lcd.print("<(Tekan)>");
   

    lcd.drawBitmap(0, 0, date1[frame], FRAME_WIDTH, FRAME_HEIGHT, 1);
    lcd.display();
    frame = (frame + 1) % FRAME_COUNT;
    delay(FRAME_DELAY);
  }
  else if (halaman == 3) {
    
    lcd.clearDisplay();

    lcd.setTextSize(1);
    lcd.setTextColor(WHITE);
    lcd.setCursor(35, 5);
    lcd.print("29 Sept 2024");
    lcd.setCursor(35,15);
    lcd.print("<(Tekan)>");

    lcd.drawBitmap(0, 0, date2[frame], FRAME_WIDTH, FRAME_HEIGHT, 1);
    lcd.display();
    frame = (frame + 1) % FRAME_COUNT;
    delay(FRAME_DELAY);
  }
  else if (halaman == 4) {

    lcd.clearDisplay();

    lcd.setTextSize(1);
    lcd.setTextColor(WHITE);
    lcd.setCursor(0, 0);
    lcd.print("Selamat Ulang tahun");
    lcd.setCursor(0,10);
    lcd.print("Fatma...");
    lcd.setCursor(0,20);
    lcd.print("<(Tekan)>");
    
  }
  else if (halaman == 5) {

    lcd.clearDisplay();

    lcd.setTextSize(1);
    lcd.setTextColor(WHITE);
    lcd.setCursor(35, 5);
    lcd.print("Potong kuenya");
    lcd.setTextSize(1);
    lcd.setCursor(35,15);
    lcd.print("<(Tekan)>");
   

    lcd.drawBitmap(0, 0, cake[frame], FRAME_WIDTH, FRAME_HEIGHT, 1);
    lcd.display();
    frame = (frame + 1) % FRAME_COUNT;
    delay(FRAME_DELAY);
    
  }
   else if (halaman == 6) {
    lcd.clearDisplay();
    lcd.setTextSize(1);
    lcd.setTextColor(WHITE);
    lcd.setCursor(0, 0);
    lcd.print("naa sekarang kuenya");
    lcd.setTextSize(1);
    lcd.setCursor(0,10);
    lcd.print("di bagi dong, ms icak");
    lcd.setCursor(0,20);
    lcd.print("minta disuapin tuh wk");
  }


 

  lcd.display();
}


